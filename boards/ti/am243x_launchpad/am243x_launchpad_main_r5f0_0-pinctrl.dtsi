/*
 * Copyright (c) 2025 Siemens Mobility GmbH
 *
 * SPDX-License-Identifier: Apache-2.0
 */

#include <zephyr/dt-bindings/pinctrl/ti-k3-pinctrl.h>

&pinctrl {
	uart0_rx_default: uart0_rx_default {
		pinmux = <K3_PINMUX(0x01d4, PIN_INPUT, MUX_MODE_2)>;
	};

	uart0_tx_default: uart0_tx_default {
		pinmux = <K3_PINMUX(0x01d8, PIN_OUTPUT, MUX_MODE_2)>;
	};

	led0_output: led0_output { // GPIO0 22
		pinmux = <K3_PINMUX(0x0058, PIN_OUTPUT, MUX_MODE_7)>;
	};

	// the other leds can't be controlled due to
	// https://github.com/zephyrproject-rtos/zephyr/issues/81100
};
