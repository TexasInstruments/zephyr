## boards/ti/am13e230x_lp/am13e230x_lp_defconfig
```kconfig
# Copyright (c) 2026 Texas Instruments Incorporated
#
# SPDX-License-Identifier: Apache-2.0

# Use SRAM as ROMABLE_REGION in Linker Script
CONFIG_XIP=n
```

## boards/ti/am13e230x_lp/board.yml
```yaml
board:
  name: am13e230x_lp
  full_name: AM13E230X Launchpad
  vendor: ti
  socs:
    - name: am13e230x
  revision:
    format: custom
    default: "e1"
    exact: false
    revisions:
      - name: "e1"
      - name: "e2"
```

## boards/ti/am243x_evm/am243x_evm_am2434_m4_defconfig
```kconfig
# Texas Instruments Sitara AM243x M4
#
# Copyright (c) 2025 Texas Instruments Incorporated
#
# SPDX-License-Identifier: Apache-2.0

# Platform Configuration
CONFIG_CORTEX_M_SYSTICK=y

# Zephyr Kernel Configuration
CONFIG_XIP=n

# Serial Driver
CONFIG_SERIAL=y

# GPIO Driver
CONFIG_GPIO=y

# Enable Console
CONFIG_CONSOLE=y
CONFIG_UART_CONSOLE=y

CONFIG_KERNEL_ENTRY="__start"
```

## boards/ti/am243x_launchpad/Kconfig.am243x_launchpad
```kconfig
# Texas Instruments AM243x Launchpad
#
# Copyright (c) 2025 Siemens Mobility GmbH
#
# SPDX-License-Identifier: Apache-2.0

config BOARD_AM243X_LAUNCHPAD
	select SOC_AM2434_R5F0_0 if BOARD_AM243X_LAUNCHPAD_AM2434_R5F0_0
	select SOC_AM2434_R5F0_0_BOOT if BOARD_AM243X_LAUNCHPAD_AM2434_R5F0_0_BOOT
```

## boards/ti/am243x_launchpad/am243x_launchpad_main_r5f0_0_defconfig
```kconfig
# Texas Instruments AM243x Launchpad
#
# Copyright (c) 2025 Siemens Mobility GmbH
#
# SPDX-License-Identifier: Apache-2.0

CONFIG_SYS_CLOCK_HW_CYCLES_PER_SEC=25000000

# XIP is deactivated for now since we have no flash support yet
CONFIG_XIP=n

# Serial Driver
CONFIG_SERIAL=y

# Enable Console
CONFIG_CONSOLE=y
CONFIG_UART_CONSOLE=y
```

## boards/ti/am243x_launchpad/am243x_launchpad_r5f0_0_defconfig
```kconfig
# Texas Instruments AM243x Launchpad
#
# Copyright (c) 2025 Siemens Mobility GmbH
#
# SPDX-License-Identifier: Apache-2.0

# XIP is deactivated for now since we have no flash support yet
CONFIG_XIP=n

# Serial Driver
CONFIG_SERIAL=y

# Enable Console
CONFIG_CONSOLE=y
CONFIG_UART_CONSOLE=y
```

## boards/ti/am243x_launchpad/board.yml
```yaml
# Copyright (c) 2025 Siemens Mobility GmbH
# SPDX-License-Identifier: Apache-2.0
board:
  name: am243x_launchpad
  full_name: TI AM243x LaunchPad
  vendor: ti
  socs:
  - name: am2434
    variants:
    - name: 'boot'
      cpucluster: 'r5f0_0'
```

## drivers/clock_control/Kconfig.am13e
```kconfig
# TI AM13E Family
#
# Copyright (c) 2026, Texas Instruments Incorporated
# SPDX-License-Identifier: Apache-2.0

config CLOCK_CONTROL_AM13E
	bool "TI AM13E clock control"
	default y
	depends on DT_HAS_TI_AM13E_CLK_ENABLED
	help
	  Enable clock control driver for the TI AM13E SoC family.
	  Provides clock frequency queries (get_rate) and configures the
	  HFCLK, SYSPLL, MCLK, MCLK2, MCLK4 and HSCLK tree from
	  device tree properties at PRE_KERNEL_1.
```

## drivers/dma/Kconfig.ti_am13
```kconfig
# Copyright (c) 2026 Texas Instruments Incorporated
# SPDX-License-Identifier: Apache-2.0

config DMA_TI_AM13
	bool "TI AM13x DMA Driver"
	default y
	depends on DT_HAS_TI_AM13_DMA_ENABLED
	help
		DMA driver for TI AM13x.
```

## drivers/dma/Kconfig.ti_edma
```kconfig
# Copyright (c) 2025 Texas Instruments
# SPDX-License-Identifier: Apache-2.0

config DMA_TI_EDMA
	bool "TI EDMA driver"
	default y
	depends on DT_HAS_TI_EDMA_ENABLED
	help
		Generic EDMA driver.

config EDMA_NUM_INSTANCES
	int "Number of EDMA IP present on SoC"
	default 1
	help
		Number of EDMA IPs present on SoC
```

## drivers/firmware/Kconfig
```kconfig
# Copyright 2024 NXP
# SPDX-License-Identifier: Apache-2.0

menu "Firmware drivers"

config ARM_SCMI
	bool "Support for ARM's SCMI"
	depends on ARM || ARM64
	help
	  Enable support for ARM's System Configuration and Management
	  Interface (SCMI).

source "drivers/firmware/scmi/Kconfig"

config TISCI
	bool "TISCI Firmware driver"
	default y
	depends on DT_HAS_TI_K2G_SCI_ENABLED
	select MBOX
	help
	  TISCI firmware driver is a frontend interface
	  to TI System Controller interface firmware through
	  secureproxy mailbox.

source "drivers/firmware/ti_sci/Kconfig"

endmenu
```

## drivers/firmware/ti_sci/Kconfig
```kconfig
# Copyright (c) 2025, Texas Instruments
# SPDX-License-Identifier: Apache-2.0

if TISCI

config TISCI_INIT_PRIORITY
	int "TISCI init priority"
	default KERNEL_INIT_PRIORITY_OBJECTS
	help
	  Init priority for the TISCI driver.

endif
```

## drivers/mspi/Kconfig.ti_k3
```kconfig
# Copyright (c) 2025 Siemens Mobility GmbH
# SPDX-License-Identifier: Apache-2.0

config MSPI_TI_K3
	bool "TI K3 MSPI driver"
	default y
	depends on DT_HAS_TI_K3_MSPI_CONTROLLER_ENABLED
	select PINCTRL
	help
	  Enable driver for Ti Keystone 3 devices
```

## dts/bindings/clock/ti,am13e-clk.yaml
```yaml
# Copyright (c) 2026 Texas Instruments Incorporated
# SPDX-License-Identifier: Apache-2.0

description: TI AM13E clock node

compatible: "ti,am13e-clk"

include: [clock-controller.yaml, base.yaml]

properties:
  "#clock-cells":
    const: 1

  clocks:
    description: Parent clock source reference

  clock-frequency:
    type: int
    description: Output clock frequency in Hz

  ti,sysctl-base:
    type: int
    description: |
      SYSCTL Registers base.

clock-cells:
  - clk
```

## dts/bindings/clock/ti,am13e-osc.yaml
```yaml
# Copyright (c) 2026 Texas Instruments Incorporated
# SPDX-License-Identifier: Apache-2.0

description: TI AM13E oscillator (XTAL or internal)

compatible: "ti,am13e-osc"

include: [fixed-clock.yaml, base.yaml]

properties:
  "#clock-cells":
    const: 0

  ti,xtal-startup-delay:
    type: int
    description: |
      Crystal oscillator startup time, stored in units of 64 us
      (value = delay_us / 64). Applies only to the HFXT (external
      crystal) oscillator.
```

## dts/bindings/clock/ti,am13e-pll.yaml
```yaml
# Copyright (c) 2026 Texas Instruments Incorporated
# SPDX-License-Identifier: Apache-2.0

description: |
  TI AM13E SYSPLL node.

  The SYSPLL output frequency formula:
    F_VCO  = (F_REF / p-div) * (q-div + 1)
    F_CLK0 = F_VCO / clk0-div
    F_CLK1 = F_VCO / clk1-div

  Example for 200 MHz output with a 25 MHz HFXTAL:
    p-div   = 2   -> F_input = 12.5 MHz  (in 8-16 MHz range)
    q-div   = 31  -> F_VCO   = 400 MHz
    clk0-div = 2  -> CLK0    = 200 MHz
    clk1-div = 2  -> CLK1    = 200 MHz

compatible: "ti,am13e-pll"

include: [clock-controller.yaml, base.yaml]

properties:
  "#clock-cells":
    const: 1

  clocks:
    required: true
    description: Reference clock source (hfclk or sysosc)

  clock-frequency:
    type: int
    required: true
    description: CLK0 output frequency in Hz (used for clock-frequency reporting)

  ti,p-div:
    type: int
    required: true
    description: |
      PLL reference pre-divider. Valid values: 1, 2, 4, 8.

  ti,q-div:
    type: int
    required: true
    description: |
      PLL feedback divider. Effective multiplier = q-div + 1.
      Valid range: 1 to 126 (register value 0 to 125).

  ti,clk0-div:
    type: int
    description: |
      CLK0 output divider. Even values 2..32. Omit to disable CLK0.

  ti,clk1-div:
    type: int
    description: |
      CLK1 output divider. Even values 2..32. Omit to disable CLK1.

clock-cells:
  - clk
```

## dts/bindings/dma/ti,am13-dma.yaml
```yaml
# Copyright (c) 2025, Texas Instruments
# SPDX-License-Identifier: Apache-2.0

description: |
  TI AM13x DMA Controller

compatible: "ti,am13-dma"

include: dma-controller.yaml

properties:
  reg:
    required: true

  interrupts:
    required: true

  dma-channels:
    required: true

  "#dma-cells":
    const: 1
    description: No specific input is needed from dts to use eDMA
```

## dts/bindings/dma/ti,edma.yaml
```yaml
# Copyright (c) 2025, Texas Instruments
# SPDX-License-Identifier: Apache-2.0

description: |
  TI EDMA controller

  Supported Functions:
    dma_configure()
    dma_start()
    dma_stop()
    dma_release_channel()
    dma_get_status()

  Key assumptions/limitations:
  - Channel number equals TCC number ( driver-internal assumption )
  - Supports only M2M, P2M, and M2P transfer directions
  - For M2M, Block size MUST be a multiple of data size (application must pad appropriately)
  - For M2P/P2M, Block size MUST be a multiple of Burst Length (application must pad appropriately)
  - This driver does NOT support chaining, linked transfers, or gather/scatter operations.

compatible: "ti,edma"

include: dma-controller.yaml

properties:
  reg:
    required: true

  interrupts:
    required: true

  dma-channels:
    required: true

  edma-params:
    type: int
    description: Number of PaRAM sets present in edma
    required: true

  edma-regions:
    type: int
    description: Number of Regions present in EDMA
    required: true

  edma-queues:
    type: int
    description: Number of Event Queues (TCs) present in edma
    required: true

  region-id:
    type: int
    description: Region ID for the EDMA controller
        Driver checks if region-id is less than a maximum value of SOC_EDMA_NUM_REGIONS
    required: true

  queue-number:
    type: int
    description: Queue number for the EDMA controller.
        Must be less than number of Transfer Controllers in EDMA hardware.
    required: true

  edma-resources:
    type: array
    description: |
      Array of EDMA resources.
      Each EDMA Resource is an array in following format:
      <EDMA_RESOURCE_TYPE start_index end_index>

      Where EDMA_RESOURCE_TYPE is an enumeration with the following values:
      0: RESOURCE_TYPE_DMA_CHANNEL - DMA channel resource
      1: RESOURCE_TYPE_PARAM - PaRAM set

      Example: To set: Core_DMA channels from 0 to 20 AND 25 to 30, Param sets from 120 to 194,
        DTS configuration:
          edma-resources = <RESOURCE_TYPE_DMA_CHANNEL 0 20>, <RESOURCE_TYPE_DMA_CHANNEL 25 30>,
          <RESOURCE_TYPE_PARAM 120 194>;
      NOTE: The ranges used above are inclusive, boundary values are included
    required: true

  "#dma-cells":
    const: 1
    description: No specific input is needed from dts to use eDMA

dma-cells:
  - channel
```

## dts/bindings/mspi/ti,mspi-k3-controller.yaml
```yaml
# Copyright (c) 2025 Siemens Mobility GmbH
# SPDX-License-Identifier: Apache-2.0

description: TI K3 MSPI Controller

compatible: "ti,k3-mspi-controller"

include: [mspi-controller.yaml, pinctrl-device.yaml]

properties:
  reg:
    required: true
    description: |
      Address and length of the MSPI configuration register and the indirect
      write FIFO location.

  ce-gpios:
    description: |
      The used chip select GPIO pins. This property is not used since the driver
      only supports the hardware controlled chip select pins.

  sram-allocated-for-read:
    required: true
    type: int
    description: |
      Amount of SRAM that is allocated for read data from the MSPI bus. The rest
      is allocated for data written to the MSPI bus.
      The value needs to be between 0 and 255
```

## dts/bindings/mtd/infineon,s25h-flash.yaml
```yaml
# Copyright (c) 2025 Siemens Mobility GmbH
# SPDX-License-Identifier: Apache-2.0

description: MSPI Infineon S25H Flash

compatible: "infineon,s25h-flash"

on-bus: mspi

include: ["flash-controller.yaml", "pinctrl-device.yaml", "mspi-device.yaml"]

properties:
  reg:
    required: true

  reset-startup-time-us:
    required: true
    type: int
    description: Time the device requires to recover after a reset in microseconds
```

## dts/bindings/power-domain/ti,sci-pm-domain.yaml
```yaml
# Copyright 2025 Texas Instruments
# SPDX-License-Identifier: Apache-2.0

description: TISCI managed power domain

compatible: "ti,sci-pm-domain"

include: 
  - base.yaml

properties:
  "#power-domain-cells":
    type: int 
    const: 1
    description:
      Contains device id
power-domain-cells:
  - devid
```

## dts/bindings/spi/ti,unicomm-spi.yaml
```yaml
# Copyright (c) 2026 Texas Instruments Incorporated
# SPDX-License-Identifier: Apache-2.0

description: TI Unicomm SPI controller

compatible: "ti,unicomm-spi"

include: [spi-controller.yaml, pinctrl-device.yaml, base.yaml]

properties:
  reg:
    required: true

  interrupts:
    required: true

  pinctrl-0:
    required: true

  pinctrl-names:
    required: true
```

## modules/Kconfig.am13
```kconfig
# Copyright (c) 2026 Texas Instruments Incorporated
# SPDX-License-Identifier: Apache-2.0

config HAS_AM13X_MCU_SDK
	bool
```

## soc/ti/am13/am13e/Kconfig
```kconfig
# Copyright (c) 2025 Texas Instruments
# SPDX-License-Identifier: Apache-2.0

config SOC_AM13E2X
	select ARM
	select ARMV8_M_DSP
	select BUILD_OUTPUT_BIN
	select BUILD_OUTPUT_HEX
	select CPU_CORTEX_M33
	select CPU_CORTEX_M_HAS_SYSTICK
	select CPU_CORTEX_M_HAS_VTOR
	select CPU_HAS_ARM_MPU
	select CPU_HAS_FPU
```

## soc/ti/am13/am13e/Kconfig.defconfig
```kconfig
# Texas Instruments AM13E MCU Series
#
# Copyright (c) 2026 Texas Instruments Incorporated
#
# SPDX-License-Identifier: Apache-2.0

if SOC_SERIES_AM13E

config NUM_IRQS
	default 48

config SYS_CLOCK_HW_CYCLES_PER_SEC
	default 200000000

endif # SOC_SERIES_AM13E
```
