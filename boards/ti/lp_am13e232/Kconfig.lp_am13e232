## boards/ti/lp_am13e232/Kconfig.lp_am13e232
```kconfig
# Copyright (c) 2026 Texas Instruments Incorporated
#
# SPDX-License-Identifier: Apache-2.0

config BOARD_LP_AM13E232
	select SOC_AM13E232
```

## boards/ti/lp_am13e232/board.yml
```yaml
# Copyright (c) 2026 Texas Instruments Incorporated
# SPDX-License-Identifier: Apache-2.0

board:
  name: lp_am13e232
  full_name: AM13E232 Launchpad
  vendor: ti
  socs:
    - name: am13e232
```

## boards/ti/lp_em_cc2340r5/Kconfig.defconfig
```kconfig
# Copyright (c) 2024 Texas Instruments Incorporated
#
# SPDX-License-Identifier: Apache-2.0

rsource "../lpf3_common/Kconfig.defconfig"

if BOARD_LP_EM_CC2340R5

config BT_CTLR
	default BT

if BT
config ZEPHYR
  bool "Bluetooth TI Controller on ZEPHYR"

  select BT_CTLR_ADV_EXT_SUPPORT
  select BT_CTLR_CHAN_SEL_2_SUPPORT
  select BT_CTLR_DTM_HCI_SUPPORT

  help
    Bluetooth TI Controller on ZEPHYR OS.
  default y

config BT_HOST_CRYPTO
  bool
  default y if !BT_HCI_RAW

config BT_LL_HEAP_SIZE
    hex
    default 0x1800

config BT_BUF_EVT_RX_SIZE
  default 255

config BT_BUF_ACL_RX_SIZE
  default 255

config BT_BUF_ACL_TX_SIZE
  default 255

config BT_BUF_CMD_TX_SIZE
  default 255

config BT_COMPANY_ID
  default 0x000D

endif # BT

endif # BOARD_LP_EM_CC2340R5
```

## boards/ti/lp_em_cc35x1/lp_em_cc35x1_cc3501e_defconfig
```kconfig
#
# Copyright (c) 2026 Conclusive Engineering Sp. z o.o.
#
# SPDX-License-Identifier: Apache-2.0
#

CONFIG_SHARED_MULTI_HEAP=y

CONFIG_GPIO=y
CONFIG_GPIO_GET_CONFIG=y
CONFIG_GPIO_GET_DIRECTION=y
CONFIG_GPIO_HOGS=y
CONFIG_GPIO_SHELL=y
CONFIG_GPIO_SHELL_INFO_CMD=y
CONFIG_GPIO_SHELL_TOGGLE_CMD=y
CONFIG_GPIO_SHELL_BLINK_CMD=y

CONFIG_SERIAL=y

CONFIG_CONSOLE=y
CONFIG_UART_CONSOLE=y
CONFIG_SHELL=y
CONFIG_SHELL_STACK_SIZE=4096
CONFIG_UART_INTERRUPT_DRIVEN=y
CONFIG_SHELL_BACKEND_SERIAL_INTERRUPT_DRIVEN=y
CONFIG_SHELL_BACKEND_SERIAL_API_INTERRUPT_DRIVEN=y

CONFIG_FLASH=y
CONFIG_SOC_FLASH_CC35XX=y
CONFIG_FLASH_SHELL=y

CONFIG_SPI=y
CONFIG_SPI_CC35XX=y
CONFIG_SPI_SHELL=y

CONFIG_DMA=y

CONFIG_ADC=y
CONFIG_ADC_CC35XX=y
CONFIG_ADC_SHELL=y

CONFIG_I2C=y
CONFIG_I2C_CC35XX=y
CONFIG_I2C_SHELL=y

CONFIG_PWM=y
CONFIG_PWM_CC35XX_TIMER=y
```

## boards/ti/lp_em_cc35x1/lp_em_cc35x1_cc3550e_defconfig
```kconfig
#
# Copyright (c) 2026 Conclusive Engineering Sp. z o.o.
#
# SPDX-License-Identifier: Apache-2.0
#

CONFIG_SHARED_MULTI_HEAP=y
CONFIG_THREAD_STACK_INFO=y
CONFIG_DYNAMIC_THREAD=y
CONFIG_ENTROPY_GENERATOR=y
CONFIG_ENTROPY_CC35XX_RNG=y

CONFIG_GPIO=y

CONFIG_SERIAL=y

CONFIG_CONSOLE=y
CONFIG_UART_CONSOLE=y
```

## drivers/adc/Kconfig.cc35xx
```kconfig
# SPDX-License-Identifier: Apache-2.0

config ADC_CC35XX
	bool "CC35XX ADC driver"
	default y
	depends on DT_HAS_TI_CC35XX_ADC_ENABLED
	help
	  This option enables the CC35XX ADC driver.
```

## drivers/counter/Kconfig.lgpt_lpf3
```kconfig
# Copyright (c) 2024 BayLibre, SAS
# Copyright (c) 2025 Texas Instruments Incorporated
# SPDX-License-Identifier: Apache-2.0

config COUNTER_LGPT_LPF3
	bool "TI LPF3 (CC23x0/CC27xx) Counter driver based on the LGPT Timer"
	default y
	depends on DT_HAS_TI_LPF3_LGPT_ENABLED
	help
	  Enable counter driver based on LGPT timer for TI LPF3 devices
	  (CC23x0 and CC27xx).
```

## drivers/entropy/Kconfig.cc35xx
```kconfig
# TI CC35xxE entropy driver configuration

# Copyright (c) 2025 Conclusive Engineering Sp. z o.o.
# SPDX-License-Identifier: Apache-2.0

config ENTROPY_CC35XX_RNG
	bool "TI SimpleLink CC35xxE Hardware Security Module (HSM)"
	default y
	depends on DT_HAS_TI_CC35XX_HSM_ENABLED
	select TI_CC35XX_HSM
	select ENTROPY_HAS_DRIVER
	select RING_BUFFER
	help
	  This option enables the driver for the Hardware Security Module (HSM)
	  for TI SimpleLink CC35xxE SoCs.

config TI_CC35XX_HSM
	bool
	depends on DT_HAS_TI_CC35XX_HSM_ENABLED

if ENTROPY_CC35XX_RNG

config ENTROPY_CC35XX_POOL_SIZE
	int "Number of bytes in the entropy pool"
	default 512
	range 256 65536
	help
	  The size in bytes of the buffer used to store entropy generated by the
	  hardware. Should be a power of two for high performance.

endif # ENTROPY_CC35XX_RNG
```

## drivers/wifi/ti_cc3xxx/Kconfig.ti_cc3xxx
```kconfig
# Texas Instruments CC3XXX Wi-Fi driver options

# Copyright (c) 2025-2026 Conclusive Engineering sp. z o. o.
# SPDX-License-Identifier: Apache-2.0

menuconfig WIFI_TI_CC3XXX
	bool "Texas Instruments CC3XXX Wi-Fi driver support"
	select WIFI_USE_NATIVE_NETWORKING
	select WIFI_OFFLOAD
	select NET_L2_WIFI_MGMT
	select DYNAMIC_THREAD
	select DYNAMIC_THREAD_ALLOC
	select THREAD_STACK_INFO
	select POSIX_API
	select SHARED_MULTI_HEAP
	select FLASH
	select FLASH_MAP
	select NVS
	select INIT_STACKS

if WIFI_TI_CC3XXX

config WIFI_TI_CC3XXX_MTU
	int "Maximum size of a packet, in bytes"
	# MTU (ipv4) per: http://www.ti.com/lit/ug/swru455d/swru455d.pdf:
	default 1472
	help
	  Set the maximum size of a network packet going through the chip.
	  This sets the size of each buffer, in each buffer pool.
	  Do not modify it unless you know what you are doing.

config WIFI_TI_CC3XXX_TX_CTRL_BLK_NUM
	int "Number of TX control block entries"
	default 120
	range 32 120
	help
	  Number of TX packet descriptors the WiFi stack can queue
	  simultaneously. Each entry uses ~344 bytes of heap.
	  Increase for high-throughput workloads.

config WIFI_TI_CC3XXX_NVS_INIT_PRIORITY
	int "NVS init priority"
	default 60
	help
	  SYS_INIT priority for the WiFi NVS init.
	  Must be lower than the WiFi driver init priority (80).

config WIFI_TI_CC33XX
	bool
	default y if (DT_HAS_TI_CC33XX_SPI_ENABLED || DT_HAS_TI_CC33XX_SDIO_ENABLED)
	select EVENTS if DT_HAS_TI_CC33XX_SDIO_ENABLED
	select SPI if DT_HAS_TI_CC33XX_SPI_ENABLED
	select SDHC if DT_HAS_TI_CC33XX_SDIO_ENABLED
	select SDIO_STACK if DT_HAS_TI_CC33XX_SDIO_ENABLED
	select GPIO
	select ENTROPY_GENERATOR
	select WIFI_TI_CC33XX_USE_ZEPHYR_MBEDTLS
	select MBEDTLS
	select MBEDTLS_DECLARE_PRIVATE_IDENTIFIERS
	select MBEDTLS_SSL_PROTO_TLS1_2
	select MBEDTLS_KEY_EXCHANGE_ECDHE_RSA_ENABLED
	select MBEDTLS_X509_CRT_PARSE_C
	select MBEDTLS_PKCS5_C
	select MBEDTLS_PK_WRITE_C
	select MBEDTLS_CTR_DRBG_C
	select MBEDTLS_ENTROPY_C
	select MBEDTLS_MD_C
	select MBEDTLS_PSA_CRYPTO_C if !BUILD_WITH_TFM
	select MBEDTLS_KEY_EXCHANGE_PSK_ENABLED
	select MBEDTLS_HAVE_TIME_DATE
	select PSA_WANT_ALG_ECDSA
	select PSA_WANT_ALG_SHA_1
	select PSA_WANT_ALG_SHA_256
	select PSA_WANT_ALG_SHA_384
	select PSA_WANT_ALG_SHA_512
	select PSA_WANT_ALG_MD5
	select PSA_WANT_ALG_HMAC
	select PSA_WANT_ALG_ECB_NO_PADDING
	select PSA_WANT_ALG_CBC_NO_PADDING
	select PSA_WANT_ALG_CTR
	select PSA_WANT_ALG_ECDH
	select PSA_WANT_KEY_TYPE_AES
	select PSA_WANT_KEY_TYPE_RSA_PUBLIC_KEY
	select PSA_WANT_KEY_TYPE_RSA_KEY_PAIR_IMPORT
	select PSA_WANT_ALG_RSA_PKCS1V15_SIGN
	select PSA_WANT_ALG_RSA_PKCS1V15_CRYPT
	select PSA_WANT_KEY_TYPE_ECC_PUBLIC_KEY
	select PSA_WANT_KEY_TYPE_ECC_KEY_PAIR_IMPORT
	select PSA_WANT_KEY_TYPE_ECC_KEY_PAIR_EXPORT
	select PSA_WANT_KEY_TYPE_ECC_KEY_PAIR_GENERATE
	select PSA_WANT_KEY_TYPE_ECC_KEY_PAIR_DERIVE
	select PSA_WANT_ECC_SECP_R1_256

config WIFI_TI_CC35XX
	bool
	default y if DT_HAS_TI_CC35XX_WLAN_ENABLED
	depends on SOC_CC35XXE_HAS_WIFI || !SOC_SERIES_CC35XXE

endif # WIFI_TI_CC3XXX

if WIFI_TI_CC35XX

choice WIFI_TI_CC35XX_MBEDTLS_PLATFORM
	prompt "CC35XX Wi-Fi mbedTLS platform"
	default WIFI_TI_CC35XX_USE_ZEPHYR_MBEDTLS
	help
	  Select the mbedTLS implementation used by the CC35XX Wi-Fi host stack.

config WIFI_TI_CC35XX_USE_ZEPHYR_MBEDTLS
	bool "Use Zephyr mbedTLS for CC35XX Wi-Fi crypto"
	select ENTROPY_CC35XX_RNG
	select MBEDTLS
	select MBEDTLS_DECLARE_PRIVATE_IDENTIFIERS
	select MBEDTLS_MD_C
	select MBEDTLS_PSA_CRYPTO_C if !BUILD_WITH_TFM
	select PSA_WANT_ALG_CBC_NO_PADDING
	select PSA_WANT_ALG_CTR
	select PSA_WANT_ALG_ECDH
	select PSA_WANT_ALG_ECB_NO_PADDING
	select PSA_WANT_ALG_FFDH
	select PSA_WANT_ALG_HMAC
	select PSA_WANT_ALG_MD5
	select PSA_WANT_ALG_SHA_1
	select PSA_WANT_ALG_SHA_256
	select PSA_WANT_ALG_SHA_384
	select PSA_WANT_ALG_SHA_512
	select PSA_WANT_ECC_SECP_R1_256
	select PSA_WANT_KEY_TYPE_AES
	select PSA_WANT_KEY_TYPE_DH_KEY_PAIR_GENERATE
	select PSA_WANT_KEY_TYPE_DH_PUBLIC_KEY
	select PSA_WANT_KEY_TYPE_ECC_KEY_PAIR_DERIVE
	select PSA_WANT_KEY_TYPE_ECC_PUBLIC_KEY
	select PSA_WANT_KEY_TYPE_HMAC
	help
	  Build the CC35XX Wi-Fi host crypto glue against Zephyr mbedTLS.

config WIFI_TI_CC35XX_USE_TI_MBEDTLS
	bool "Use TI SDK mbedTLS for CC35XX Wi-Fi crypto"
	select TI_CC35XX_HSM
	select TI_CC35XX_HSM_ITS
	help
	  Build the CC35XX Wi-Fi host crypto glue against the mbedTLS
	  implementation bundled with the TI SimpleLink SDK. This cannot be
	  combined with Zephyr mbedTLS or PSA Crypto in the same image.

endchoice

endif # WIFI_TI_CC35XX

if WIFI_TI_CC33XX

config WIFI_TI_CC33XX_USE_ZEPHYR_MBEDTLS
	bool
	depends on WIFI_TI_CC33XX
	help
	  CC33XX Wi-Fi host crypto glue is always built against Zephyr mbedTLS.
	  Selected by WIFI_TI_CC33XX.

config WIFI_TI_CC33XX_USE_ZEPHYR_PSA_AES
	bool "Use Zephyr PSA Crypto API for AES in CC33XX"
	depends on WIFI_TI_CC33XX_USE_ZEPHYR_MBEDTLS
	default y
	select PSA_WANT_ALG_ECB_NO_PADDING
	select PSA_WANT_ALG_CBC_NO_PADDING
	select PSA_WANT_ALG_CTR
	select PSA_WANT_KEY_TYPE_AES
	help
	  Use PSA Crypto API instead of the legacy mbedtls_aes_* API for
	  AES operations in the CC33XX WPA crypto backend.

config WIFI_TI_CC33XX_USE_TI_DYNAMIC_DPL_OBJECTS
	bool "Use dynamic allocation for TI DPL objects"
	default y
	help
	  Enable dynamic memory allocation for objects created by the TI DPL.

endif # WIFI_TI_CC33XX
```

## dts/bindings/adc/ti,cc35xx-adc.yaml
```yaml
# SPDX-License-Identifier: Apache-2.0

description: cc35xx ADC node

compatible: "ti,cc35xx-adc"

include: [pinctrl-device.yaml, adc-controller.yaml]

properties:
  reg:
    required: true

  interrupts:
    required: true

  clkdiv:
    required: true
    type: int
    description: Select ADC clock divider.

  sample-period:
    required: true
    type: int
    description: Sample period in ADC cycles (after clock divider)

io-channel-cells:
  - input
```

## dts/bindings/counter/ti,lpf3-lgpt.yaml
```yaml
# Copyright (c) 2024 BayLibre, SAS
# Copyright (c) 2025 Texas Instruments Incorporated
# SPDX-License-Identifier: Apache-2.0

description: TI LPF3 (CC23x0/CC27xx) LGPT counter driver

compatible: "ti,lpf3-lgpt"

include: base.yaml

properties:
  freq:
    type: int
    description: clock frequency (only used for external clock sources)

  interrupts:
    required: true

  clk-prescale:
    type: int
    required: true
    description: Counter clock prescale

  max-top-value:
    type: int
    required: true
    description: Max allowed value for counter
```

## dts/bindings/wifi/ti,cc33xx-sdio.yaml
```yaml
# Copyright (c) 2026 Conclusive Engineering Sp. z o.o.
# SPDX-License-Identifier: Apache-2.0

include: [sdhc.yaml, "ti,cc3xxx-wlan.yaml"]

description: Texas Instruments CC33XX Wi-Fi controller

compatible: "ti,cc33xx-sdio"

properties:
  wifi-host-wake-gpios:
    description: |
      Host wake-up gpio. Signal from the CC33XX Wi-Fi device
      to the host indicating that the device requires attention.
    type: phandle-array

  bus-width:
    description: |
      Specifies the physical data bus width allocated for the SDIO interface.
      Must match the actual number of data traces (DAT0-DAT3) routed on the PCB
      between the host controller and the CC33XX chip.
    type: int
    enum:
      - 1
      - 4
    default: 4
```

## dts/bindings/wifi/ti,cc3xxx-wlan.yaml
```yaml
# Copyright (c) 2026 Conclusive Engineering Sp. z o.o.
# SPDX-License-Identifier: Apache-2.0

description: Texas Instruments CC3XXX Wi-Fi controller

compatible: "ti,cc3xxx-wlan"

properties:
  heap-regions:
    description: |
      An array of one or more phandles pointing to the physical internal SRAM nodes
      backing the Wi-Fi heap management subsystem. All referenced memory blocks
      must be configured as non-cacheable.

      WARNING: Zephyr's shared multi-heap does not detect overlaps. A region also
      registered elsewhere would corrupt a live heap. The board/overlay maintainer
      must keep these regions exclusive to the Wi-Fi heap.
    type: phandles
    required: true
```

## samples/bluetooth/esl/ap_cli/Kconfig
```kconfig
# EtherMind ESL AP Options
#
# Use this Kconfig for AP builds only.
# Set options in prj.conf, e.g.:
#   CONFIG_BT_ESL_AP=y
#

source "$ZEPHYR_BASE/Kconfig"

menu "EtherMind ESL AP Options"

config BT_ESL_AP
    bool "Enable ESL Access Point Role"
    default n

config BT_ESL_SEPARATE_KEY_PER_GROUP
    bool "Enable Separate Key Per Group (AP only)"
    depends on BT_ESL_AP
    default n

config BT_ESL_VENDOR_SPECIFIC_COMMANDS
    bool "Enable ESL Vendor Specific Commands"
    default n

config ESL_PL_DEBUG_TO_CONSOLE
    bool "Enable diverting ESL-PL Debug Logs to Console as Printk"
    default n

# ESL Common Limits
config BT_ESL_MAX_SENSOR_SUPPORTED
    int "Maximum # of Sensor to be supported"
    range 1 256
    default 256

config BT_ESL_MAX_LED_SUPPORTED
    int "Maximum # of LED to be supported"
    range 1 256
    default 256

config BT_ESL_MAX_IMAGE_SUPPORTED
    int "Maximum # of Image to be supported"
    range 1 256
    default 256

config BT_ESL_MAX_DISPLAY_SUPPORTED
    int "Maximum # of Display to be supported"
    range 1 102
    default 102

config BT_ESL_MAX_NO_OF_RESPONSE
    int "Maximum # of Responses to be supported"
    range 1 24
    default 24

config BT_ESL_MAX_GROUPS_SUPPORTED
    int "Maximum # of Groups to be supported"
    range 1 128
    default 128

config BT_ESL_MAX_ESL_TAGS_SUPPORTED
    int "Maximum # of Tags to be supported"
    range 1 255
    default 255

endmenu
```

## samples/bluetooth/mesh/boards/teensy41.conf
```kconfig
CONFIG_BT_HCI_TI_CC3XXX=y

CONFIG_REBOOT=y
CONFIG_HWINFO=y

CONFIG_NETWORKING=y
CONFIG_NET_L2_ETHERNET=y
CONFIG_NET_TX_STACK_SIZE=2048
CONFIG_NET_RX_STACK_SIZE=2048

CONFIG_HEAP_MEM_POOL_SIZE=75776
CONFIG_MAIN_STACK_SIZE=61440
CONFIG_SYSTEM_WORKQUEUE_STACK_SIZE=8192
CONFIG_DYNAMIC_THREAD_PREFER_POOL=y
CONFIG_DYNAMIC_THREAD_POOL_SIZE=4
CONFIG_DYNAMIC_THREAD_STACK_SIZE=8192

CONFIG_BT_MESH_ADV_BUF_COUNT=16
CONFIG_BT_BUF_ACL_RX_SIZE=255
CONFIG_BT_BUF_EVT_DISCARDABLE_SIZE=255
CONFIG_BT_BUF_EVT_RX_SIZE=255

CONFIG_BT_HCI_ACL_FLOW_CONTROL=n
CONFIG_BT_PHY_UPDATE=n
CONFIG_BT_AUTO_PHY_UPDATE=n

CONFIG_ETH_NXP_ENET_USE_DTCM_FOR_DMA_BUFFER=n
```

## samples/net/wifi/shell/boards/teensy41.conf
```kconfig
CONFIG_WIFI=y
CONFIG_WIFI_TI_CC3XXX=y

CONFIG_NETWORKING=y
CONFIG_NET_IPV4=y
CONFIG_NET_IPV6=n
CONFIG_NET_MGMT=y
CONFIG_NET_IF_MAX_IPV4_COUNT=2

CONFIG_IDLE_STACK_SIZE=2048
CONFIG_MPU_ALLOW_FLASH_WRITE=y
CONFIG_HEAP_MEM_POOL_SIZE=24576
CONFIG_MAIN_STACK_SIZE=61440
CONFIG_SYSTEM_WORKQUEUE_STACK_SIZE=2048

CONFIG_MBEDTLS_BUILTIN=y

CONFIG_NET_BUF_DATA_SIZE=1536
CONFIG_NET_PKT_RX_COUNT=64
CONFIG_NET_PKT_TX_COUNT=24
CONFIG_NET_BUF_RX_COUNT=64
CONFIG_NET_BUF_TX_COUNT=24

CONFIG_NET_RX_STACK_SIZE=2048
CONFIG_NET_TX_STACK_SIZE=2048
CONFIG_NET_TCP_WORKQ_STACK_SIZE=2048
CONFIG_NET_MGMT_EVENT_QUEUE_SIZE=128
CONFIG_NET_MGMT_EVENT_QUEUE_TIMEOUT=500
CONFIG_NET_MAX_CONTEXTS=10
CONFIG_NET_L2_ETHERNET=y
CONFIG_WIFI_SHELL_MAX_AP_STA=4

CONFIG_NET_MGMT_EVENT_STACK_SIZE=4096

CONFIG_DYNAMIC_THREAD_PREFER_POOL=y
CONFIG_DYNAMIC_THREAD_POOL_SIZE=3
CONFIG_DYNAMIC_THREAD_STACK_SIZE=8192

CONFIG_ETH_NXP_ENET_USE_DTCM_FOR_DMA_BUFFER=n
```
