## CMakeLists.txt
```
#
# Copyright (c) 2026 Texas Instruments Incorporated
#
# SPDX-License-Identifier: Apache-2.0

cmake_minimum_required(VERSION 3.20.0)

find_package(Zephyr REQUIRED HINTS $ENV{ZEPHYR_BASE})
project(flash_operations_scheduler)

target_sources(app PRIVATE src/main.c)
target_sources(app PRIVATE src/flsopskd_wrapper.c)
```

## Kconfig
```
# Copyright (c) 2026 Texas Instruments Incorporated
# SPDX-License-Identifier: Apache-2.0

source "Kconfig.zephyr"

config FLSOPSKD_INT_MODE
    bool "Use this KConfig to overwrite SDK's implementation of Busy Poll"
    default y
    help
      The wrapper implements Interrupt based status check, 
      instead of SDK's Busy Polling mode.

config FLSOPSKD_INT_NUM
    int "Interrupt Number for Flash Operation Scheduler"
    default 202
    depends on FLSOPSKD_INT_MODE
    help
      Interrupt Number from SDK for FLSOPSKD interrupt based usage. this should match the SDK's 
      CSLR_R5FSS0_CORE0_INTR_FOTA_STAT_INTR

config FLSOPSKD_INT_PRIO
    int "Interrupt Priority for the Flash Scheduler completion status"
    default 5
    depends on FLSOPSKD_INT_MODE
    help
       Interrupt Priority for FLSOPSKD interrupt based usage
```

## prj.conf
```kconfig
#Enable Console
CONFIG_CONSOLE=y
CONFIG_UART_CONSOLE=y

CONFIG_PRINTK=y
```

## src/main.c
```c
/*
 * Copyright (c) 2026 Texas Instruments Incorporated
 *
 * SPDX-License-Identifier: Apache-2.0
 */

#include <stdio.h>
#include "flsopskd_wrapper.h"
#include <zephyr/kernel.h>

#include <zephyr/cache.h>

#define FLASH_BASE 0x60000000
#define APP_FLASH_OFFSET 0x200000

#define BUFFER_SIZE 1024U*4

#define COMP_BUF_MATCH 1
#define COMP_BUF_NOMATCH 0

#define BUFFER_FILL true
#define BUFFER_CLEAR false

#define MAX_ITERATIONS 1000

/* app semaphore for write request */
K_SEM_DEFINE(app_write_req_sem, 0, 1);

/* app semaphore for write completion */
K_SEM_DEFINE(app_write_comp_sem, 0, 1);

/* App Array of 8bit data to be written to flash of size 1024 */
uint8_t app_data[BUFFER_SIZE] = {0};

/* empty buffer to read to */
uint8_t read_buffer[BUFFER_SIZE] = {0};

/* pointer to read flash from */
uint8_t *flash_ptr = (uint8_t *)(FLASH_BASE + APP_FLASH_OFFSET);

/* variable to return the flash write success / fail */
int flash_write_ret = 0;

/* util function to populate app_data */
void populate_app_data(bool fill)
{
    for (int i = 0; i < BUFFER_SIZE; i++)
    {
        if (fill == BUFFER_FILL) {
            app_data[i] = i;
        } else {
            /* BUFFER_CLEAR */
            app_data[i] = 0;
        }
    }
}

/* util function to write app_data to flash */
void write_app_data_to_flash(void)
{
    while(1){
        /* wait for the write request */
        k_sem_take(&app_write_req_sem, K_FOREVER);

        flsopskd_wrapper_erase(APP_FLASH_OFFSET, BUFFER_SIZE);

        /* Implementation for writing to flash */
        flash_write_ret = flsopskd_wrapper_write(app_data, BUFFER_SIZE, APP_FLASH_OFFSET);

        /* post the semaphore */
        k_sem_give(&app_write_comp_sem);
    }

}

/* util function to read app_data from flash */
void read_app_data_from_flash(uint8_t *buffer, size_t size)
{
    /* Implementation for reading from flash */
    /* Since DAC mode is enabled, we can read directly using the flash_ptr */

    for (size_t i = 0; i < size; i++)
    {
        buffer[i] = flash_ptr[i];
    }

    return;
}

/* compare buffers */
int compare_buffers(uint8_t *buf1, uint8_t *buf2, size_t size)
{
    for (size_t i = 0; i < size; i++)
    {
        if (buf1[i] != buf2[i])
        {
            return COMP_BUF_NOMATCH; // buffers are not the same
        }
    }
    return COMP_BUF_MATCH; // buffers are the same
}

int main(void)
{

    int buff_match = COMP_BUF_NOMATCH;
    int fill = BUFFER_FILL;
    int error_count = 0;

    /* Check if the OSPI0 is in DAC mode and Flash is enabled
        read the app_data from flash and expect no abort
    */
    read_app_data_from_flash(read_buffer, BUFFER_SIZE);

    /* if no abort, then the read is successful and the OSPI0 is in DAC mode */
    printf("Flash (OSPI0 DAC mode) reads succesfully without abort, OSPI0 is in DAC mode\n");

    buff_match = compare_buffers(read_buffer, flash_ptr, BUFFER_SIZE);

    if (buff_match != COMP_BUF_MATCH)
    {
        printk("Flash read buffer non-zero\n");
    }

    /* init the flsopskd_wrapper */
    flsopskd_wrapper_init();


    for (int iteration = 0; iteration < MAX_ITERATIONS; iteration++)
    {

        if (iteration % 2 == 0) {
            fill = BUFFER_FILL;
        } else {
            fill = BUFFER_CLEAR;
        }

        /* populate app_data */
        populate_app_data(fill);

        /* write flash with app_data. initiate write request */
        k_sem_give(&app_write_req_sem);

        /* wait on the write completion */
        k_sem_take(&app_write_comp_sem, K_FOREVER);

        printk("write completion status : %d | \t", flash_write_ret);

        /* invalidate Data Cache */
        sys_cache_data_invd_range(flash_ptr, BUFFER_SIZE);

        /* read and compare buffers */
        read_app_data_from_flash(read_buffer, BUFFER_SIZE);

        buff_match = compare_buffers(read_buffer, app_data, BUFFER_SIZE);

        if (buff_match != COMP_BUF_MATCH)
        {
            printk("FAILED.    \t fill : %d. Iteration : %d\n", fill, iteration);
            error_count++;
        } else {
            printk("SUCCESS.   \t fill : %d. Iteration : %d\n", fill, iteration);
        }

        k_sleep(K_MSEC(100));
    }

    printk("Test Complete. Number of errors : %d\n", error_count);

	return 0;
}

/* size of stack area used by each thread */
#define STACKSIZE 1024

/* scheduling priority used by each thread */
#define PRIORITY 7

K_THREAD_DEFINE(write_id, STACKSIZE, write_app_data_to_flash, NULL, NULL, NULL,
		PRIORITY, 0, 0);
```

## src/flsopskd_wrapper.c
```c
/*
 * Copyright (c) 2026 Texas Instruments Incorporated
 *
 * SPDX-License-Identifier: Apache-2.0
 */

#include <stdio.h>
#include "flsopskd_wrapper.h"
#include <zephyr/kernel.h>

/* SDK drivers */
#include <flsopskd.h>

K_MUTEX_DEFINE(flsopskd_write_mutex);

#ifdef CONFIG_FLSOPSKD_INT_MODE

/* Semaphore to pend on */
K_SEM_DEFINE(flsopskd_int_status_sem, 0, 1);

#define FLSOPSKD_IRQ_PRIORITY   CONFIG_FLSOPSKD_INT_PRIO
#define FLSOPSKD_IRQ_FLAGS      IRQ_TYPE_EDGE
#define FLSOPSKD_IRQ_NUM        CONFIG_FLSOPSKD_INT_NUM

/* ISR for posting the semaphore */
void flsopskd_isr(void *args)
{   
    CSL_fss_fota_genregsRegs *pReg = (CSL_fss_fota_genregsRegs *)(CSL_FSS_FOTA_GENREGS_REGS_BASE);

    /* get status */
    volatile uint32_t status = CSL_REG32_RD(&pReg->STS_IRQ.STATUS);
    
    /* Clearing the Interrupt Status */
    CSL_REG32_WR(&pReg->STS_IRQ.EOI, 1);
    CSL_REG32_WR(&pReg->STS_IRQ.STATUS, 1);
    
    if(status != 0) {
        /* Post the semaphore to indicate flash operation completion */
        k_sem_give(&flsopskd_int_status_sem);
    }
    
}

/* Redefinition to a SDK's non-busypoll */
int32_t FLSOPSKD_busyPoll(FLSOPSKD_Handle *pHandle)
{   
    ARG_UNUSED(pHandle);
    
    int ret = k_sem_take(&flsopskd_int_status_sem, K_FOREVER);
    
    if (ret == 0){
        return 0;
    }
    
    /* timeout occurred */
    return -ret;
}
#else 

/* Redefinition to a SDK's non-busypoll */
int32_t FLSOPSKD_busyPoll(FLSOPSKD_Handle *pHandle)
{   
    ARG_UNUSED(pHandle);
    
    CSL_fss_fota_genregsRegs *pReg = (const CSL_fss_fota_genregsRegs *)(CSL_FSS_FOTA_GENREGS_REGS_BASE);

    while(1){
        if (CSL_REG32_RD(&pReg->STS_IRQ.STATUS_RAW) !=0) {
            CSL_REG32_WR(&pReg->STS_IRQ.STATUS, 1);
            break;
        } else {
            /* do nothing */
        }
    }
    
    return 0;
}

#endif /* !(CONFIG_FLSOPSKD_INT_MODE) */


/* Wrapper constants for flash operations - Macronix */
#define EXT_FLASH_ERASE_OPCODE      (0x21U)
#define EXT_FLASH_ERASE_EXTOPCODE   (0xDEU)
#define EXT_FLASH_ERASE_SIZE        (4096U)
#define EXT_FLASH_PAGE_SIZE         (256U)

FLSOPSKD_Handle gFlopsdkHandle;
FLSOPSKD_Params params;

void flsopskd_wrapper_init(void)
{

    FLSOPSKD_Params_init(&params);
    params.eraseOpCode = EXT_FLASH_ERASE_OPCODE;
    params.eraseExOpCode = EXT_FLASH_ERASE_EXTOPCODE;
    params.pageSizeInBytes = EXT_FLASH_PAGE_SIZE;
    params.eraseSizeInBytes = EXT_FLASH_ERASE_SIZE;
    FLSOPSKD_init(&gFlopsdkHandle, &params);

#ifdef CONFIG_FLSOPSKD_INT_MODE

    CSL_fss_fota_genregsRegs *pReg = (CSL_fss_fota_genregsRegs *)(CSL_FSS_FOTA_GENREGS_REGS_BASE);

    CSL_REG32_WR(&pReg->STS_IRQ.STATUS, 1);
    CSL_REG32_WR(&pReg->STS_IRQ.EOI, 1);
    CSL_REG32_WR(&pReg->STS_IRQ.ENABLE_SET, 1);

    /* Register the ISR */
    IRQ_CONNECT(FLSOPSKD_IRQ_NUM, FLSOPSKD_IRQ_PRIORITY, flsopskd_isr, NULL, FLSOPSKD_IRQ_FLAGS);
    irq_enable(FLSOPSKD_IRQ_NUM);

#endif /* !(CONFIG_FLSOPSKD_INT_MODE) */
}

void flsopskd_wrapper_deinit(void)
{
    FLSOPSKD_deinit(&gFlopsdkHandle);

#ifdef CONFIG_FLSOPSKD_INT_MODE

    /* IRQ_DISCONNECT */
    irq_disable(FLSOPSKD_IRQ_NUM);

#endif /* !(CONFIG_FLSOPSKD_INT_MODE) */
}

/* wrapper takes a 8bit array and flash offset address to write to */
int flsopskd_wrapper_write( uint8_t *data, uint32_t length, uint32_t offset)
{   
    volatile uint32_t start_ticks;
    volatile uint32_t stop_ticks;

    /* Basic checks on the args */
    if (data == NULL || length == 0)
    {
        printk("FLSOPSKD Wrapper Write: Invalid data or length\n");
        return -ENOTSUP;
    }

    /* lock mutex */
    k_mutex_lock(&flsopskd_write_mutex, K_FOREVER);

    start_ticks = k_cycle_get_32();

    /* start flash write operations */
    int32_t ret = FLSOPSKD_write(&gFlopsdkHandle, offset, (uint8_t*)data, length);

    stop_ticks = k_cycle_get_32();

    k_mutex_unlock(&flsopskd_write_mutex);

    if (ret != 0)
    {
        printk("FLSOPSKD Wrapper Write: Write operation failed\n");
        return -EIO;
    }

    printk("FLSOPSKD Wrapper Write: Write Operation Success | Ticks : %d\n", stop_ticks - start_ticks);

    return 0;
}

int flsopskd_wrapper_erase(uint32_t offset, uint32_t length)
{   
    int num_pages_to_erase;

    int32_t ret = -ENOTSUP;
    
    /* 
     *  Take offset and length. calculate the number of erase blocks 
     *  and then erase those many blocks 
     */

    /* Basic checks on the args */
    if (length == 0)
    {
        printk("FLSOPSKD Wrapper Erase: Invalid length\n");
        return -ENOTSUP;
    }

    /* check if offset is aligned to minimum block size of flash */
    if (offset % EXT_FLASH_ERASE_SIZE != 0)
    {
        printk("FLSOPSKD Wrapper Erase: Offset is not aligned to erase block size\n");
        return -ENOTSUP;
    }

    /* calc number of pages needed to be erased */
    num_pages_to_erase = (length + EXT_FLASH_ERASE_SIZE - 1) / EXT_FLASH_ERASE_SIZE;

    printk("FLSOPSKD Wrapper Erase: Starting erase from offset 0x%08x to offset 0x%08x\n", offset, offset + num_pages_to_erase * EXT_FLASH_ERASE_SIZE);

    /* for loop on all the erase blocks if the len > erase block size */
    
    /* start flash erase operations */
    for (int page = 0; page < num_pages_to_erase; page++)
    {
        uint32_t page_offset = offset + (page * EXT_FLASH_ERASE_SIZE);

        /* lock mutex */
        k_mutex_lock(&flsopskd_write_mutex, K_FOREVER);

        /* erase flash page */
        ret = FLSOPSKD_erase(&gFlopsdkHandle, offset);

        /* unlock mutex */
        k_mutex_unlock(&flsopskd_write_mutex);

        /* check erase return value and proceed for further erases if successful */
        if (ret != 0)
        {
            printk("FLSOPSKD Wrapper Erase: Erase operation failed at page offset 0x%08x\n", page_offset);
            return -EIO;
        } else {
            printk("FLSOPSKD Wrapper Erase: Successfully erased page at offset 0x%08x\n", page_offset);
        }
    }
    
    if (ret != 0)
    {
        printk("FLSOPSKD Wrapper Erase: Erase operation failed\n");
        return -EIO;
    }

    return 0;
}

int flsopskd_wrapper_write_status(void)
{
    /* 
     * Try to acquire the write mutex and if the mutex is available, 
     * then the write is complete. 
     * Other wise, the write is still in progress 
     */

    if (k_mutex_lock(&flsopskd_write_mutex, K_NO_WAIT) == 0)
    {
        k_mutex_unlock(&flsopskd_write_mutex);
        return 0; /* Write is complete */
    }

    return -EIO; /* Write is still in progress */
}
```

## src/flsopskd_wrapper.h
```c
/*
 * Copyright (c) 2026 Texas Instruments Incorporated
 *
 * SPDX-License-Identifier: Apache-2.0
 */

/**
 * @file flsopskd_wrapper.h
 * @brief Wrapper functions for FLSOPSKD flash operations from MCU_PLUS_SDK
 * 
 */

#include <stdio.h>
#include <stdint.h>

/**
 * @brief API to initilize flsopskd wrapper module
 * 
 * @return * void 
 */
void flsopskd_wrapper_init(void);

/**
 * @brief API to de-initialize flsopskd wrapper module
 * 
 */
void flsopskd_wrapper_deinit(void);

/**
 * @brief API to write to flash using flsopskd wrapper module.
 * 
 * CONFIG_BUSY_POLL will determine whether the API will use 
 * busy polling or interrupt based mechanism to track the write completion.
 * 
 * Use flsopskd_wrapper_write_status API to track the write status when using busy polling mechanism.
 * 
 * @param data 
 * @param length 
 * @param offset 
 * @return * void 
 */
int flsopskd_wrapper_write( uint8_t *data, uint32_t length, uint32_t offset);

/**
 * @brief API to erase flash using flsopskd wrapper module.
 * 
 * @param offset 
 * @param length 
 * @return * void 
 */
int flsopskd_wrapper_erase(uint32_t offset, uint32_t length);

/**
 * @brief 
 * 
 * @return int 
 */
int flsopskd_wrapper_write_status(void);
```
