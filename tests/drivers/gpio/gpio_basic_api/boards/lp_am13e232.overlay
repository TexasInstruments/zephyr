/*
 * SPDX-FileCopyrightText: 2026 Texas Instruments
 *
 * SPDX-License-Identifier: Apache-2.0
 */

/*
 * GPIO loopback test resources for LP-AM13E232.
 * Jumper PA29 (out-gpios) to PA30 (in-gpios) for the runtime loopback test.
 */

/ {
	resources {
		compatible = "test-gpio-basic-api";
		out-gpios = <&gpioa 29 GPIO_ACTIVE_HIGH>; /* PA29 */

		in-gpios = <&gpioa 30 GPIO_ACTIVE_HIGH>; /* PA30 */
	};
};
