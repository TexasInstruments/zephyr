## soc/ti/simplelink/cc35xxe/Kconfig.soc
```kconfig
# Copyright (c) 2025 Conclusive Engineering Sp. z o.o.
#
# SPDX-License-Identifier: Apache-2.0

config SOC_SERIES_CC35XXE
	bool
	select SOC_FAMILY_TI_SIMPLELINK
	help
	  Enable support for TI SimpleLink CC35xxE SoCs

config SOC_CC3500E
	bool
	select SOC_SERIES_CC35XXE
	select SOC_CC35XXE_HAS_WIFI

config SOC_CC3501E
	bool
	select SOC_SERIES_CC35XXE
	select SOC_CC35XXE_HAS_WIFI
	select SOC_CC35XXE_HAS_BT

config SOC_CC3550E
	bool
	select SOC_SERIES_CC35XXE
	select SOC_CC35XXE_HAS_WIFI
	select SOC_CC35XXE_HAS_WIFI_5GHZ

config SOC_CC3551E
	bool
	select SOC_SERIES_CC35XXE
	select SOC_CC35XXE_HAS_WIFI
	select SOC_CC35XXE_HAS_WIFI_5GHZ
	select SOC_CC35XXE_HAS_BT

config SOC_CC35XXE_HAS_WIFI
	bool

config SOC_CC35XXE_HAS_WIFI_5GHZ
	bool

config SOC_CC35XXE_HAS_BT
	bool

config SOC_SERIES
	string
	default "cc35xxe" if SOC_SERIES_CC35XXE

config SOC
	string
	default "cc3500e" if SOC_CC3500E
	default "cc3501e" if SOC_CC3501E
	default "cc3550e" if SOC_CC3550E
	default "cc3551e" if SOC_CC3551E

config CC35XXE_SIGN_PRIVATE_KEY_FILE
	string "Path to the private key used to sign the image"

config CC35XXE_SIGN_PUBLIC_KEY_FILE
	string "Path to the public key used to sign the image"

config CC35XXE_FLASH_DISCOVERY_CONFIG_OTFDE
	string "Path to the OTFDE configuration file"

config CC35XXE_FLASH_DISCOVERY_CONFIG_EXT_MEM
	string "Path to the external memory configuration file"

config CC35XXE_FLASH_DISCOVERY_CONFIG_XSPI
	string "Path to the xSPI configuration file"

config CC35XXE_FUSE_CONFIG
	string "Path to the fuse configuration file"

config CC35XXE_ACTION_PARAMS_FILE
	string "Path to the action parameters file"

config CC35XXE_CONF_INI_FILE
	string "Path to the cc35xx-conf.ini file"
	help
	  Override the default cc35xx-conf.ini file used to generate
	  cc35xx-conf.bin during the build. If left empty, the in-tree
	  default at soc/ti/simplelink/cc35xxe/conf/cc35xx-conf.ini is
	  used.
```

## tests/drivers/spi/spi_controller_peripheral/boards/lp_em_cc35x1_cc3551e.conf
```kconfig
CONFIG_SYSTEM_WORKQUEUE_STACK_SIZE=2048
CONFIG_SPI_CONTROLLER_PERIPHERAL_EXTENDED_TESTS=y
```

## tests/drivers/watchdog/wdt_basic_api/boards/lp_em_cc35x1_cc3551e.conf
```kconfig
# Copyright (c) 2026 Conclusive Engineering Sp. z o.o.
# SPDX-License-Identifier: Apache-2.0

CONFIG_TEST_WDT_NOINIT_SECTION=".noinit.test_wdt"
```
