## soc/ti/am26x/am261x/Kconfig
```kconfig
# Texas Instruments AM261x MCU series
#
# Copyright (c) 2025 Texas Instruments Incorporated
#
# SPDX-License-Identifier: Apache-2.0

config SOC_SERIES_AM261X_R5F
	select ARM
	select ARM_CUSTOM_INTERRUPT_CONTROLLER
	select CPU_CORTEX_R5
	select CPU_HAS_ARM_MPU
	select CPU_HAS_FPU
	select CPU_HAS_DCACHE
	select CPU_HAS_ICACHE
	select DMA
	select PINCTRL
	select SOC_EARLY_INIT_HOOK
	select UART_NS16550_ACCESS_WORD_ONLY if UART_NS16550
	select VIM

config SOC_PART_NUMBER
	default "AM2612" if SOC_AM261X_R5F0_0 || SOC_AM261X_R5F0_1
```

## soc/ti/am26x/am261x/Kconfig.defconfig
```kconfig
# Texas Instruments AM261x MCU series
#
# Copyright (c) 2025 Texas Instruments Incorporated
#
# SPDX-License-Identifier: Apache-2.0

if SOC_SERIES_AM261X

config MAX_CPUS_NUM
	int
	default 2 if SOC_SERIES_AM261X

config KERNEL_ENTRY
	default "_vector_table" if SOC_SERIES_AM261X_R5F

config SYS_CLOCK_HW_CYCLES_PER_SEC
	# Input frequency to RTI is 250MHz, but prescaler halves frequency to 125MHz by default
	default 125000000

config NUM_IRQS
	default 222

config ARM_MPU
	default y if SOC_SERIES_AM261X_R5F

if SERIAL

config UART_NS16550
	default y

config UART_NS16550_TI_K3
	default y if SOC_SERIES_AM261X_R5F

config SERIAL_SUPPORT_ASYNC
	default y if SOC_SERIES_AM261X_R5F

choice UART_NS16550_VARIANT
	default UART_NS16550_VARIANT_NS16750
endchoice

endif # SERIAL

config DCACHE_LINE_SIZE
	default 32 if CPU_HAS_DCACHE

config ICACHE_LINE_SIZE
	default 32 if CPU_HAS_ICACHE

config EDMA_NUM_INSTANCES
	default 1

endif # SOC_SERIES_AM261X
```

## soc/ti/k3/am6x/Kconfig
```kconfig
# Copyright (c) 2023 Enphase Energy
# Copyright (c) 2025 Siemens Mobility GmbH
# SPDX-License-Identifier: Apache-2.0

config BUILD_OUTPUT_TI_K3_ROM_LOADABLE
	bool "Build image that can be loaded by the TI K3 ROM bootloader"
	default n
	depends on BUILD_OUTPUT_BIN
	help
		Selecting this output will generate a output binary in a form that the
		TI K3 ROM bootloader can load. Selecting this requires you to specify
		other Kconfig options to point to e.g. binary blobs.

config TI_K3_SYSFW_LOAD_ADDR
	hex
	depends on BUILD_OUTPUT_TI_K3_ROM_LOADABLE
	default 0x44000 if SOC_AM2434_R5F0_0_BOOT
	help
		Address where the SYSFW needs to be loaded to. This info will land in
		the X509 certificate of the TI K3 ROM loadable image.

config TI_K3_SYSFW_BLOB_PATH
	string "Path to SYSFW binary blob"
	depends on BUILD_OUTPUT_TI_K3_ROM_LOADABLE
	help
		Path to the unencrypted SYSFW binary blob that can be found inside the
		TI MCU+ SDK.

config TI_K3_SYSFW_CERT_PATH
	string "Path to certificate for SYSFW binary blob"
	depends on BUILD_OUTPUT_TI_K3_ROM_LOADABLE
	help
		Path to the X509 certificate for the SYSFW binary blob. Can be found
		inside the TI MCU+ SDK.

config TI_K3_BOARDCONFIG_PATH
	string "Path to binary boardconfig file"
	depends on BUILD_OUTPUT_TI_K3_ROM_LOADABLE
	help
		Path to the default boardconfig binary. Can be obtained from the TI MCU+
		SDK.

config TI_K3_PRIVATE_KEY_PATH
	string "Path to private key used to sign TI K3 ROM loadable image"
	depends on BUILD_OUTPUT_TI_K3_ROM_LOADABLE
	help
		Path to the private key with which the X509 certificate inside the TI K3
		ROM loadable image should be signed. Due to an errata in some SoCs it's
		recommended to take a degenerate key (instructions for generating one
		can be found inside the AM2434 TRM or the file can be obtained from the
		TI MCU+ SDK)

config SOC_SERIES_AM6X_A53
	select ARM64
	select CPU_CORTEX_A53
	select ARM_ARCH_TIMER if SYS_CLOCK_EXISTS

config SOC_SERIES_AM6X_M4
	select ARM
	select CPU_CORTEX_M4
	select CPU_HAS_FPU
	select CPU_CORTEX_M_HAS_SYSTICK
	select DYNAMIC_INTERRUPTS
	select CPU_CORTEX_M_HAS_DWT
	select OPENAMP_RSC_TABLE
	select UART_NS16550_ACCESS_WORD_ONLY
	select EXTERNAL_ADDRESS_TRANSLATION
	select MM_DRV
	select MM_TI_RAT
	select SOC_EARLY_INIT_HOOK

config SOC_SERIES_AM6X_R5
	select ARM
	select CPU_CORTEX_R5
	select CPU_HAS_ARM_MPU
	select VFP_SP_D16
	select ARM_CUSTOM_INTERRUPT_CONTROLLER
	select VIM
	select TI_DM_TIMER
	select UART_NS16550_ACCESS_WORD_ONLY if UART_NS16550
	select SOC_EARLY_INIT_HOOK

config SOC_J721E_MAIN_R5F0_0
	select OPENAMP_RSC_TABLE

config SOC_J722S_MAIN_R5F0_0
	select OPENAMP_RSC_TABLE

config SOC_J722S_MCU_R5F0_0
	select OPENAMP_RSC_TABLE

config SOC_PART_NUMBER
	default "AM2434" if SOC_AM2434_M4 || SOC_AM2434_R5F
	default "AM6232" if SOC_AM6232_A53
	default "AM6232" if SOC_AM6232_M4
	default "AM6234" if SOC_AM6234_A53
	default "AM6234" if SOC_AM6234_M4
	default "AM6254" if SOC_AM6254_M4 || SOC_AM6254_A53
	default "AM6442" if SOC_AM6442_M4
	default "AM6442" if SOC_AM6442_R5F0_0
	default "AM6442" if SOC_AM6442_R5F0_1
	default "AM6442" if SOC_AM6442_R5F1_0
	default "AM6442" if SOC_AM6442_R5F1_1
	default "J721e" if SOC_J721E_MAIN_R5F0_0
```

## soc/ti/k3/am6x/Kconfig.defconfig.am243x
```kconfig
# Copyright (c) 2025 Siemens Mobility GmbH
# SPDX-License-Identifier: Apache-2.0

if SOC_AM2434_MAIN_R5F0_0

config NUM_IRQS
	default 256

config SYS_CLOCK_HW_CYCLES_PER_SEC
	default 25000000

config ROMSTART_RELOCATION_ROM
	default y

config ROMSTART_REGION_ADDRESS
	default $(dt_nodelabel_reg_addr_hex,atcm_boot)
config ROMSTART_REGION_SIZE
	default $(dt_nodelabel_reg_size_hex,atcm_boot,0,K)

# The MPU needs to be enabled to mark the SRAM as non-shared. Otherwise atomic
# instructions (used for e.g. semaphores and logging) cause data aborts.
# Another option is to locate those in the L1-TCM but there is no easy way to do
# this currently
config MPU
	default y

config ARM_MPU
	default y

endif # SOC_SERIES_AM6X_R5
```

## soc/ti/k3/am6x/Kconfig.defconfig.am6x
```kconfig
# Copyright (c) 2023 Enphase Energy
# Copyright (c) 2025 Siemens Mobility GmbH
# SPDX-License-Identifier: Apache-2.0

if SOC_AM6234_A53 || SOC_AM6234_M4 || SOC_AM6442_M4

config NUM_IRQS
	default 64 if SOC_SERIES_AM6X_M4
	default 280 if SOC_SERIES_AM6X_A53

config SYS_CLOCK_HW_CYCLES_PER_SEC
	default 400000000 if SOC_SERIES_AM6X_M4
	default 200000000 if SOC_SERIES_AM6X_A53

endif # SOC_AM6234_A53 || SOC_AM6234_M4 || SOC_AM6442_M4
```

## soc/ti/k3/am6x/Kconfig.defconfig.am6x_am243x
```kconfig
# Copyright (c) 2023 Enphase Energy
# Copyright (c) 2025 Siemens Mobility GmbH
# SPDX-License-Identifier: Apache-2.0

if SOC_AM6234_A53 || SOC_AM6234_M4 || SOC_AM6442_M4 || SOC_AM2434_R5F0_0 || SOC_AM2434_M4

config NUM_IRQS
	default 64 if SOC_SERIES_AM6X_M4
	default 256 if SOC_SERIES_AM6X_R5
	default 280 if SOC_SERIES_AM6X_A53

config SYS_CLOCK_HW_CYCLES_PER_SEC
	default 400000000 if SOC_SERIES_AM6X_M4
	default 200000000 if SOC_SERIES_AM6X_R5
	default 200000000 if SOC_SERIES_AM6X_A53

config ARM_MPU
	default y if SOC_SERIES_AM6X_R5

config ROMSTART_RELOCATION_ROM
	default y if SOC_SERIES_AM6X_R5

config ROMSTART_REGION_ADDRESS
	default $(dt_nodelabel_reg_addr_hex,atcm_boot) if SOC_SERIES_AM6X_R5

config ROMSTART_REGION_SIZE
	default $(dt_nodelabel_reg_size_hex,atcm_boot,0,K) if SOC_SERIES_AM6X_R5

endif # SOC_AM6234_A53 || SOC_AM6234_M4 || SOC_AM6442_M4 || SOC_AM2434_R5F0_0 || SOC_AM2434_M4
```

## soc/ti/k3/am6x/Kconfig.defconfig.j72x
```kconfig
# Copyright (c) 2023 Enphase Energy
# Copyright (c) 2025 Siemens Mobility GmbH
# SPDX-License-Identifier: Apache-2.0

if SOC_J721E_MAIN_R5F0_0 || SOC_J722S_MAIN_R5F0_0 || SOC_J722S_MCU_R5F0_0

config NUM_IRQS
	default 512

config SYS_CLOCK_HW_CYCLES_PER_SEC
	default 19200000

endif # SOC_J721E_MAIN_R5F0_0 || SOC_J722S_MAIN_R5F0_0 || SOC_J722S_MCU_R5F0_0
```

## tests/drivers/dma/chan_blen_transfer/boards/am261x_lp_am2612_r5f0_1.conf
```kconfig
CONFIG_DMA=y

CONFIG_CACHE_MANAGEMENT=n
CONFIG_DCACHE=n
CONFIG_ICACHE=n

CONFIG_DMA_TRANSFER_CHANNEL_NR_0=32
CONFIG_DMA_TRANSFER_CHANNEL_NR_1=33
```

## tests/drivers/mspi/flash/testcase.yaml
```yaml
# Copyright (c) 2024 Ambiq Micro Inc. <www.ambiq.com>
# Copyright (c) 2025 Siemens Mobility GmbH
# SPDX-License-Identifier: Apache-2.0

common:
  tags:
    - drivers
    - mspi
    - flash
  harness: ztest

tests:
  drivers.mspi.flash:
    filter: dt_compat_enabled("zephyr,mspi-emul-flash")
      or dt_compat_enabled("jedec,spi-nor") or dt_compat_enabled("jedec,mspi-nor")
      or dt_compat_enabled("mspi-atxp032") or dt_compat_enabled("mspi-is25xX0xx")
      or dt_compat_enabled("cdns,mspi-controller.yaml")
    harness: ztest
    platform_allow:
      - native_sim
      - apollo3p_evb
      - apollo510_evb
      - am243x_launchpad/am2434/r5f0_0
    integration_platforms:
      - native_sim
      - apollo3p_evb
      - apollo510_evb
      - am243x_launchpad/am2434/r5f0_0
  drivers.mspi.flash.xip_read:
    filter: dt_compat_enabled("mspi-is25xX0xx")
    platform_allow:
      - apollo510_evb
    integration_platforms:
      - apollo510_evb
    extra_configs:
      - CONFIG_FLASH_MSPI_XIP_READ=y
  drivers.mspi.flash.mspi_dw_system_workqueue:
    filter: dt_alias_exists("mspi0") and dt_compat_enabled("jedec,mspi-nor")
      and CONFIG_MSPI_DW
    integration_platforms:
      - nrf54h20dk/nrf54h20/cpuapp
    extra_configs:
      - CONFIG_MSPI_DW_HANDLE_FIFOS_IN_SYSTEM_WORKQUEUE=y
  drivers.mspi.flash.mspi_nor_no_multithreading:
    filter: dt_alias_exists("mspi0") and CONFIG_FLASH_MSPI_NOR
    platform_allow:
      - nrf54h20dk/nrf54h20/cpuapp
    extra_configs:
      - CONFIG_MULTITHREADING=n
```
