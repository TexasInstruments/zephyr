/*
 * Copyright (c) 2026 Texas Instruments Incorporated
 *
 * SPDX-License-Identifier: Apache-2.0
 */

/*
 * I2S speed test overlay for lp_em_cc2341r10
 *
 * DIR_BOTH loopback test configuration:
 *   DIO15 = SCLK  (BCLK, bit clock)
 *   DIO25 = WS    (WCLK, word/frame clock)
 *   DIO9  = SD0   (TX data output)
 *   DIO10 = SD1   (RX data input)
 *
 * GPIO loopback wiring: connect DIO9 (SD0) -> DIO10 (SD1)
 *
 * CC23X1 has no audio oscillator, so the I2S clocks are derived from the
 * 48 MHz reference clock. For 44 kHz, 16-bit stereo the bit clock divider is
 * 48 MHz / (44000 x 32) = 34.09, which the driver rounds to 34. TX and RX
 * share the same clock, so the loopback data is unaffected.
 */

/ {
	aliases {
		i2s-node0 = &i2s0;
	};
};

&i2s0 {
	status = "okay";
	pinctrl-0 = <&i2s0_sclk_default &i2s0_ws_default
		     &i2s0_sd0_default &i2s0_sd1_default>;
	pinctrl-names = "default";
};
