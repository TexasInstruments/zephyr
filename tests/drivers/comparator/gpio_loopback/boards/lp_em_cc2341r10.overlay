/*
 * Copyright 2026 Texas Instruments Incorporated
 *
 * SPDX-License-Identifier: Apache-2.0
 */

#include <zephyr/dt-bindings/gpio/gpio.h>

/ {
	aliases {
		test-comp = &comparator;
	};

	zephyr,user {
		test-gpios = <&gpio0 15 GPIO_ACTIVE_HIGH>;
	};
};

&comparator {
	status = "okay";
};

/* DIO15 (BP.28) drives the comparator input on DIO21 (BP.37) */
