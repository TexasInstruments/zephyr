/*
 * Copyright (c) 2026 Conclusive Engineering Sp. z o.o.
 *
 * SPDX-License-Identifier: Apache-2.0
 */

/ {
	chosen {
		zephyr,bt-hci = &hci0;
	};
};

&wlan0 {
	status = "okay";
};

&hci0 {
	status = "okay";
};
