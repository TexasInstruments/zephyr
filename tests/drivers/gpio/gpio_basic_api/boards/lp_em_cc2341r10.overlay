/*
 * Copyright (c) 2026 Texas Instruments Incorporated
 *
 * SPDX-License-Identifier: Apache-2.0
 */

/ {
	resources {
		compatible = "test-gpio-basic-api";
		/* DIO15 (BP.28) wired to DIO21 (BP.37) for GPIO loopback testing */
		out-gpios = <&gpio0 15 0>;  /* DIO15 */
		in-gpios = <&gpio0 21 0>;   /* DIO21 */
	};
};
