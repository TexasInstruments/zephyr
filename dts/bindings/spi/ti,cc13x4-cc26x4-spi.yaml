## dts/bindings/spi/ti,cc13x4-cc26x4-spi.yaml
```yaml
# Copyright (c) 2026 Texas Instruments Incorporated
# SPDX-License-Identifier: Apache-2.0

description: TI SimpleLink CC13x4 / CC26x4 SPI node

compatible: "ti,cc13x4-cc26x4-spi"

include: [spi-controller.yaml, pinctrl-device.yaml, base.yaml]

properties:
  reg:
    required: true

  interrupts:
    required: true

  dmas:
    description: |
       DMA channel specifiers for TX and RX.
       Single cell format: <&dma0 channel>

  dma-names:
    description: |
      Must be "tx" and "rx" in that order when dmas is present.
    const:
      - "tx"
      - "rx"

  pinctrl-0:
    required: true

  pinctrl-names:
    required: true
```

## dts/bindings/wifi/ti,cc35xx-wlan.yaml
```yaml
# Copyright (c) 2025 Conclusive Engineering Sp. z o.o.
# SPDX-License-Identifier: Apache-2.0

description: Texas Instruments CC35XX Wi-Fi controller

compatible: "ti,cc35xx-wlan"
```

## soc/ti/simplelink/cc13x4_cc26x4/Kconfig
```kconfig
# Texas Instruments SimpleLink CC13x4 / CC26x4

# Copyright (c) 2026 Texas Instruments Incorporated
# SPDX-License-Identifier: Apache-2.0

config SOC_SERIES_CC13X4_CC26X4
	select ARM
	select CPU_CORTEX_M33
	select CPU_HAS_FPU
	select ARMV8_M_DSP
	select CPU_HAS_ARM_MPU
	select CPU_HAS_DSP
	select DYNAMIC_INTERRUPTS
	select CPU_CORTEX_M_HAS_DWT
	select HAS_CC13X4_CC26X4_SDK
	select HAS_TI_CCFG if !BOOTLOADER_MCUBOOT
	select HAS_SEGGER_RTT if ZEPHYR_SEGGER_MODULE
	select HAS_PM
	select HAS_POWEROFF

menu "Customer Configuration (CCFG)"
depends on SOC_SERIES_CC13X4_CC26X4

config CC13X4_CC26X4_BOOTLOADER_ENABLE
	bool "ROM bootloader"
	help
	  Enable the serial bootloader in ROM on CC13x4/CC26x4 devices.
	  Default disabled per TI production recommendation.

config CC13X4_CC26X4_BOOTLOADER_BACKDOOR_ENABLE
	bool "ROM bootloader backdoor"
	depends on CC13X4_CC26X4_BOOTLOADER_ENABLE
	help
	  Enable the ROM bootloader backdoor which starts the bootloader if the
	  associated pin is at the correct logic level on reset.

config CC13X4_CC26X4_BOOTLOADER_BACKDOOR_PIN
	int "ROM bootloader backdoor pin"
	depends on CC13X4_CC26X4_BOOTLOADER_BACKDOOR_ENABLE
	range 0 $(UINT8_MAX)
	default $(UINT8_MAX)
	help
	  Set the pin that is level checked if the bootloader backdoor is
	  enabled.

config CC13X4_CC26X4_BOOTLOADER_BACKDOOR_LEVEL
	int "ROM bootloader backdoor level"
	depends on CC13X4_CC26X4_BOOTLOADER_BACKDOOR_ENABLE
	range 0 1
	default 0
	help
	  Set the active level of the pin selected for the bootloader backdoor.

config CC13X4_CC26X4_XOSC_CAPARRAY_DELTA
	hex "Cap array tuning delta"
	range 0 0xFF
	default 0xFF
	help
	  Value written to the CCFG XOSC_CAPARRAY_DELTA field, used to tune the
	  load capacitance of the high frequency crystal oscillator.

config CC13X4_CC26X4_IDAU_CFG_ENABLE
	bool "Custom TrustZone boundary configuration"
	help
	  Enables user-defined NSADDR/NSCADDR watermarks for flash and SRAM.
	  When disabled, TI factory boundaries apply.

config CC13X4_CC26X4_TZ_FLASH_NS_BOUNDARY
	hex "Flash non-secure address boundary"
	depends on CC13X4_CC26X4_IDAU_CFG_ENABLE
	range 0x0 0x3FF
	default 0x0
	help
	  SET_CCFG_TRUSTZONE_FLASH_CFG_NSADDR_BOUNDARY.
	  0x0 = all flash except lowest 8KB is non-secure.

config CC13X4_CC26X4_TZ_SRAM_NS_BOUNDARY
	hex "SRAM non-secure address boundary"
	depends on CC13X4_CC26X4_IDAU_CFG_ENABLE
	range 0x0 0x1FF
	default 0x0
	help
	  SET_CCFG_TRUSTZONE_SRAM_CFG_NSADDR_BOUNDARY.
	  0x0 = all SRAM is non-secure.

config CC13X4_CC26X4_SRAM_PARITY_DISABLE
	bool "Disable SRAM parity"
	help
	  Parity is enabled by default. TI recommends keeping it enabled
	  for any application with run-time security requirements.

endmenu
```

## tests/drivers/spi/spi_controller_peripheral/boards/lp_em_cc1354p10_1.conf
```kconfig
# Copyright (c) 2026 Texas Instruments Incorporated
# SPDX-License-Identifier: Apache-2.0

CONFIG_SPI=y
CONFIG_SPI_SLAVE=y
CONFIG_SPI_ASYNC=y
CONFIG_SPI_CC13X4_CC26X4_DMA_DRIVEN=y
```

## tests/subsys/pm/power_mgmt_soc/boards/lp_em_cc35x1_cc3551e.conf
```kconfig
# Copyright The Zephyr Project Contributors
# SPDX-License-Identifier: Apache-2.0

CONFIG_CC35XX_RTC_TIMER=y
CONFIG_TICKLESS_KERNEL=y
CONFIG_PM_DEVICE=y
CONFIG_PM_DEVICE_SYSTEM_MANAGED=y
```
