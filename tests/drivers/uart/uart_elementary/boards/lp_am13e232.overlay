/*
 * Copyright (c) 2026 Texas Instruments Incorporated
 *
 * SPDX-License-Identifier: Apache-2.0
 */

/* TX (PA7) and RX (PA24) must be connected together for loopback */
/* RTS (PA30) and CTS (PA29) must be connected together for flow control */

&unicomm0 {
	status = "okay";
};

dut: &unicomm0_uart {
	pinctrl-0 = <&uc0_tx_sda_pico_pa7 &uc0_rx_scl_sclk_pa24 &uc0_rts_poci_pa30
		     &uc0_cts_cs0_pa29>;
	pinctrl-names = "default";
	current-speed = <115200>;
	hw-flow-control;
	status = "okay";
};
