/*
 * Copyright (c) 2026 Conclusive Engineering Sp. z o.o.
 *
 * SPDX-License-Identifier: Apache-2.0
 */

#include <zephyr/dt-bindings/pinctrl/ti-cc35xx-pinctrl.h>

&uart0_default {
	group1 {
		pinmux = <P17_UART0_TX>, <P18_UART0_RX>,
			 <P16_UART0_RTS>, <P19_UART0_CTS>;
	};
};

/* UART1 remains the console; UART0 uses external TX/RX and RTS/CTS loopbacks. */
dut: &uart0 {
	status = "okay";
};
