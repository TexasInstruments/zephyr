## boards/ti/lp_em_cc1354p10/Kconfig.lp_em_cc1354p10_6
```kconfig
# Copyright (c) 2026 Texas Instruments Incorporated
#
# SPDX-License-Identifier: Apache-2.0

config BOARD_LP_EM_CC1354P10_6
	select SOC_CC1354P10
```

## boards/ti/lp_em_cc1354p10/board.yml
```yaml
# Copyright (c) 2026 Texas Instruments Incorporated
# SPDX-License-Identifier: Apache-2.0

boards:
  - name: lp_em_cc1354p10_1
    full_name: LP-EM-CC1354P10-1
    vendor: ti
    socs:
      - name: cc1354p10
  - name: lp_em_cc1354p10_6
    full_name: LP-EM-CC1354P10-6
    vendor: ti
    socs:
      - name: cc1354p10
```

## boards/ti/lp_em_cc1354p10/lp_em_cc1354p10_1_defconfig
```kconfig
# Copyright (c) 2026 Texas Instruments Incorporated
#
# SPDX-License-Identifier: Apache-2.0

CONFIG_BUILD_OUTPUT_HEX=y
CONFIG_ARM_MPU=n
CONFIG_HW_STACK_PROTECTION=y
CONFIG_GPIO=y
CONFIG_SERIAL=y
CONFIG_CONSOLE=y
CONFIG_UART_CONSOLE=y
```

## drivers/adc/Kconfig.cc13x4_cc26x4
```kconfig
# Copyright (c) 2026 Texas Instruments Incorporated
# SPDX-License-Identifier: Apache-2.0

config ADC_CC13X4_CC26X4
	bool "CC13x4/CC26x4 ADC driver"
	default y
	depends on DT_HAS_TI_CC13X4_CC26X4_ADC_ENABLED
	help
	  Enable the TI CC13x4/CC26x4 ADC driver.
```

## drivers/adc/Kconfig.cc35xx
```kconfig
# SPDX-License-Identifier: Apache-2.0

config ADC_CC35XX
	bool "CC35XX ADC driver"
	default y
	depends on DT_HAS_TI_CC35XX_ADC_ENABLED
	select PINCTRL
	help
	  This option enables the CC35XX ADC driver.

config ADC_CC35XX_DMA_DRIVEN
	bool "DMA support for TI CC35XX ADC devices"
	depends on ADC_CC35XX
	select DMA
	help
	  DMA driven mode offloads data transfer tasks from the CPU
	  and requires fewer interrupts to handle the ADC sequence mode.
	  The FIFO packs pairs of samples: DMA sequences require an even
	  channel count and a four-byte-aligned destination buffer.
	  When DMA mode is used, the ADC internal gain is not compensated
	  for measurement adjustment.
```

## drivers/dma/Kconfig.ti_cc13x4_cc26x4
```kconfig
# Copyright (c) 2026 Texas Instruments Incorporated
# SPDX-License-Identifier: Apache-2.0

config DMA_TI_CC13X4_CC26X4
	bool "TI CC13X4_CC26X4 DMA driver"
	default y
	depends on DT_HAS_TI_CC13X4_CC26X4_DMA_ENABLED
	help
	  DMA driver for TI CC13X4_CC26X4 MCUs.
```

## drivers/flash/Kconfig.lpf3
```kconfig
# Copyright (c) 2025 Texas Instruments Incorporated
# Copyright (c) 2024 BayLibre, SAS
#
# SPDX-License-Identifier: Apache-2.0

config SOC_FLASH_LPF3
	bool "TI SimpleLink LPF3 flash controller driver"
	default y
	depends on DT_HAS_TI_LPF3_FLASH_CONTROLLER_ENABLED
	select FLASH_HAS_PAGE_LAYOUT
	select FLASH_HAS_DRIVER_ENABLED
	select FLASH_HAS_EXPLICIT_ERASE
	select MPU_ALLOW_FLASH_WRITE if ARM_MPU
	help
	  Enables TI SimpleLink LPF3 flash controller driver (CC23XX/CC27XX).
```

## drivers/gpio/Kconfig.cc13x4_cc26x4
```kconfig
# Copyright (c) 2026 Texas Instruments Incorporated
# SPDX-License-Identifier: Apache-2.0

config GPIO_CC13X4_CC26X4
	bool "TI CC13x4/CC26x4 GPIO driver"
	default y
	depends on DT_HAS_TI_CC13X4_CC26X4_GPIO_ENABLED
	help
	  Enable GPIO driver for TI CC13x4/CC26x4 SoCs.
```

## drivers/gpio/Kconfig.lpf3
```kconfig
# Copyright (c) 2025 Texas Instruments Incorporated
# Copyright (c) 2024 BayLibre, SAS
#
# SPDX-License-Identifier: Apache-2.0

config GPIO_LPF3
	bool "TI SimpleLink LPF3 GPIO driver"
	default y
	depends on DT_HAS_TI_LPF3_GPIO_ENABLED
	help
	  Enable the TI SimpleLink LPF3 GPIO driver (CC23XX/CC27XX).
```

## drivers/pinctrl/Kconfig.cc13x4_cc26x4
```kconfig
# Copyright (c) 2026 Texas Instruments Incorporated
# SPDX-License-Identifier: Apache-2.0

config PINCTRL_CC13X4_CC26X4
	bool "TI SimpleLink CC13X4_CC26X4 pinctrl driver"
	default y
	depends on DT_HAS_TI_CC13X4_CC26X4_PINCTRL_ENABLED
	help
	  Enable the TI SimpleLink CC13X4_CC26X4 pinctrl driver
```

## drivers/pinctrl/Kconfig.lpf3
```kconfig
# Copyright (c) 2025 Texas Instruments Incorporated
# Copyright (c) 2024 BayLibre, SAS
#
# SPDX-License-Identifier: Apache-2.0

config PINCTRL_LPF3
	bool "TI SimpleLink LPF3 pinctrl driver"
	default y
	depends on DT_HAS_TI_LPF3_PINCTRL_ENABLED
	help
	  Enable the TI SimpleLink LPF3 pinctrl driver (CC23X0/CC27XX).
```

## drivers/serial/Kconfig.cc13x4_cc26x4
```kconfig
# Copyright (c) 2026 Texas Instruments Incorporated
# SPDX-License-Identifier: Apache-2.0

config UART_CC13X4_CC26X4
	bool "TI SimpleLink CC13x4 / CC26x4 UART driver"
	default y
	depends on DT_HAS_TI_CC13X4_CC26X4_UART_ENABLED
	select SERIAL_HAS_DRIVER
	select SERIAL_SUPPORT_INTERRUPT
	select SERIAL_SUPPORT_ASYNC
	select PINCTRL
	help
	  Enable the TI SimpleLink CC13x4 / CC26x4 UART driver.

config UART_CC13X4_CC26X4_DMA_DRIVEN
	bool "DMA support for TI CC13x4 / CC26x4 UART devices"
	default y if UART_ASYNC_API
	depends on UART_CC13X4_CC26X4
	depends on UART_ASYNC_API
	select DMA
	help
	  DMA driven mode offloads data transfer tasks from the CPU.
	  Uses the uDMA controller with hardwired channel-to-peripheral
	  mapping (no EVTSVT crossbar on CC13x4).
```

## drivers/spi/Kconfig.cc13x4_cc26x4
```kconfig
# Copyright (c) 2026 Texas Instruments Incorporated
# SPDX-License-Identifier: Apache-2.0

config SPI_CC13X4_CC26X4
	bool "TI SimpleLink CC13x4 / CC26x4 SPI driver"
	default y
	depends on DT_HAS_TI_CC13X4_CC26X4_SPI_ENABLED
	select PINCTRL
	help
	  Enable support for the TI SimpleLink CC13x4 / CC26x4 SPI peripheral.
	  Uses interrupt-driven FIFO ping-pong (TX fill + RX drain in ISR).

config SPI_CC13X4_CC26X4_DMA_DRIVEN
	bool "DMA support for TI CC13X4_CC26X4 SPI devices"
	depends on SPI_CC13X4_CC26X4
	select DMA
	help
	  DMA driven mode offloads data transfer tasks from the CPU
```

## drivers/timer/Kconfig.cc13x4_cc26x4_rtc
```kconfig
# Copyright (c) 2026 Texas Instruments Incorporated
# SPDX-License-Identifier: Apache-2.0

config CC13X4_CC26X4_RTC_TIMER
	bool "TI SimpleLink CC13x4/CC26x4 RTC system clock timer"
	default y
	depends on DT_HAS_TI_CC13X4_CC26X4_RTC_TIMER_ENABLED
	select TICKLESS_CAPABLE
	select TIMER_HAS_64BIT_CYCLE_COUNTER
	help
	  This module implements a kernel device driver for the TI SimpleLink
	  CC13X4_CC26X4 series Real Time Counter and provides the standard
	  "system clock driver" interfaces.
```

## dts/bindings/adc/ti,cc13x4-cc26x4-adc.yaml
```yaml
# Copyright (c) 2026 Texas Instruments Incorporated
# SPDX-License-Identifier: Apache-2.0

description: Texas Instruments CC13X4_CC26X4 SoC ADC

compatible: "ti,cc13x4-cc26x4-adc"

include: [adc-controller.yaml, pinctrl-device.yaml]

properties:
  reg:
    required: true

  interrupts:
    required: true

  pinctrl-0:
    required: true

  pinctrl-names:
    required: true

  "#io-channel-cells":
    const: 1

io-channel-cells:
  - input
```

## dts/bindings/dma/ti,cc13x4-cc26x4-dma.yaml
```yaml
# Copyright (c) 2026 Texas Instruments Incorporated
# SPDX-License-Identifier: Apache-2.0

description: TI CC13X4_CC26X4 DMA controller

compatible: "ti,cc13x4-cc26x4-dma"

include: dma-controller.yaml

properties:
  reg:
    required: true
  interrupts:
    required: true
  "#dma-cells":
    const: 2

dma-cells:
  - channel
  - trigsrc
```

## dts/bindings/flash_controller/ti,cc13x4-cc26x4-flash-controller.yaml
```yaml
# Copyright (c) 2026 Texas Instruments Incorporated
# SPDX-License-Identifier: Apache-2.0

description: Texas Instruments CC13x4/CC26x4 flash controller

compatible: "ti,cc13x4-cc26x4-flash-controller"

include: flash-controller.yaml
```

## dts/bindings/flash_controller/ti,lpf3-flash-controller.yaml
```yaml
# Copyright (c) 2025.2026 Texas Instruments Incorporated
# Copyright (c) 2024 BayLibre, SAS
# SPDX-License-Identifier: Apache-2.0

description: Texas Instruments LPF3 flash controller

compatible: "ti,lpf3-flash-controller"

include: flash-controller.yaml
```

## dts/bindings/gpio/ti,cc13x4-cc26x4-gpio.yaml
```yaml
# Copyright (c) 2026 Texas Instruments Incorporated
# SPDX-License-Identifier: Apache-2.0

description: TI SimpleLink CC13x4 / CC26x4 GPIO node

compatible: "ti,cc13x4-cc26x4-gpio"

include: [gpio-controller.yaml, base.yaml]

properties:
  reg:
    required: true

  interrupts:
    required: true

  "#gpio-cells":
    const: 2

gpio-cells:
  - pin
  - flags
```

## dts/bindings/gpio/ti,lpf3-gpio.yaml
```yaml
# Copyright (c) 2025 Texas Instruments Incorporated
# Copyright (c) 2024 BayLibre, SAS
#
# SPDX-License-Identifier: Apache-2.0

description: TI SimpleLink LPF3 GPIO node

compatible: "ti,lpf3-gpio"

include: [gpio-controller.yaml, base.yaml]

properties:
  reg:
    required: true

  interrupts:
    required: true

  "#gpio-cells":
    const: 2

gpio-cells:
  - pin
  - flags
```

## dts/bindings/pinctrl/ti,cc13x4-cc26x4-pinctrl.yaml
```yaml
# Copyright (c) 2022 Vaishnav Achath
# Copyright (c) 2026 Texas Instruments Incorporated
# SPDX-License-Identifier: Apache-2.0

description: |
    TI SimpleLink CC13x4 / CC26x4 pinctrl node.

    Device pin configuration should be placed in the child nodes of this node.
    Populate the 'pinmux' field with a pair consisting of a pin number and its IO
    function.

    The node has the 'pinctrl' node label set in your SoC's devicetree,
    so you can modify it like this:

      &pinctrl {
              /* your modifications go here */
      };

    All device pin configurations should be placed in child nodes of the
    'pinctrl' node, as in the uart0 example shown at the end.

    Supported standard pin properties:

    - bias-disable: Disable pull-up/down.
    - bias-pull-down: Enable pull-down resistor.
    - bias-pull-up: Enable pull-up resistor.
    - drive-open-drain: Output driver is open-drain.
    - drive-open-source: Output driver is open-source.
    - drive-strength: Minimum current that can be sourced from the pin.
    - input-enable: Enable input.
    - input-schmitt-enable: Enable input schmitt circuit.
    - ti,input-edge-detect: Enable and configure edge detection interrupts.

    Example - include the chip level pinctrl header in the board DTS:

      #include <dt-bindings/pinctrl/cc13x4_cc26x4-pinctrl.h>

    Configure UART0 TX/RX pins:

      &pinctrl {
        uart0_tx_default: uart0_tx_default {
          pinmux = <3 IOC_PORT_MCU_UART0_TX>;
          bias-disable;
        };
        uart0_rx_default: uart0_rx_default {
          pinmux = <2 IOC_PORT_MCU_UART0_RX>;
          bias-disable;
          input-enable;
        };
      };

      &uart0 {
        pinctrl-0 = <&uart0_tx_default &uart0_rx_default>;
        pinctrl-names = "default";
        status = "okay";
      };

compatible: "ti,cc13x4-cc26x4-pinctrl"

include: base.yaml

properties:
  reg:
    required: true

child-binding:
  description: |
    CC13x4/CC26x4 pin configuration node.

  include:
    - name: pincfg-node.yaml
      property-allowlist:
        - bias-disable
        - bias-pull-down
        - bias-pull-up
        - drive-open-drain
        - drive-open-source
        - drive-strength
        - input-enable
        - input-schmitt-enable

  properties:
    pinmux:
      required: true
      type: array
      description: |
        CC13x4/CC26x4 pin configuration: <IO_pin_number IO_port_function>.
        IO_port_function is an IOC_PORT_* constant from
        cc13x4_cc26x4-pinctrl.h.

    drive-strength:
      enum:
        - 2
        - 4
        - 8
      default: 2
      description: |
        Minimum output drive strength in mA.
          2: min 2 mA (SoC default)
          4: min 4 mA
          8: min 8 mA for double drive strength IOs, min 4 mA for normal IOs

    ti,input-edge-detect:
      type: int
      default: 0
      description: |
        Edge detection interrupt configuration:
          IOC_NO_EDGE (0): No edge detection (default)
          IOC_FALLING_EDGE: Edge detection on falling edge
          IOC_RISING_EDGE: Edge detection on rising edge
          IOC_BOTH_EDGES: Edge detection on both edges
```

## dts/bindings/pwm/ti,cc23x1-lgpt-pwm.yaml
```yaml
# Copyright (c) 2026 Texas Instruments Incorporated
# SPDX-License-Identifier: Apache-2.0

description: |
  TI CC23x1 LGPT PWM Controller Node

    &lgpt0 {
      status = "okay";
    };

    &pwm0 {
      status = "okay";
      pinctrl-0 = <&pwm0_default>;
      pinctrl-names = "default";
    };

  Note: PWM0-PWM8 are 16bit without prescale, max timeout is 1365312 ns (at 48MHz)
        PWM9-PWM11 are 24bit without prescale, max timeout is 349525312 ns (at 48MHz)

compatible: "ti,cc23x1-lgpt-pwm"

include: [base.yaml, pwm-controller.yaml, pinctrl-device.yaml]

properties:
  pinctrl-0:
    required: true

  pinctrl-names:
    required: true

pwm-cells:
  - channel
  - period
  - flags
```

## dts/bindings/rng/ti,lpf3-rng.yaml
```yaml
# Copyright (c) 2026 Texas Instruments Incorporated
#
# SPDX-License-Identifier: Apache-2.0

description: TI SimpleLink LPF3 RNG node

compatible: "ti,lpf3-rng"

include: [base.yaml]
```

## dts/bindings/rtc/ti,cc13x4-cc26x4-rtc-timer.yaml
```yaml
# Copyright (c) 2026 Texas Instruments Incorporated
# SPDX-License-Identifier: Apache-2.0

description: TI SimpleLink CC13x4/CC26x4 AoN RTC

compatible: "ti,cc13x4-cc26x4-rtc-timer"

include: rtc.yaml

properties:
  reg:
    required: true
```

## dts/bindings/serial/ti,cc13x4-cc26x4-uart.yaml
```yaml
# Copyright (c) 2026 Texas Instruments Incorporated
# SPDX-License-Identifier: Apache-2.0

description: TI SimpleLink CC13x4 / CC26x4 UART node

compatible: "ti,cc13x4-cc26x4-uart"

include: [uart-controller.yaml, pinctrl-device.yaml, base.yaml]

properties:
  reg:
    required: true

  interrupts:
    required: true
```
