/*
 * Copyright (c) 2025 Texas Instruments Incorporated
 *
 * SPDX-License-Identifier: Apache-2.0
 */

/ {
	reserved-memory {
		/* Reserved for SBL residing in Flash */
		ospi_sbl_flash: memory@60000000 {
			reg = <0x60000000 DT_SIZE_M(16)>;
			compatible = "zephyr,memory-region";
			zephyr,memory-region = "OSPI_SBL_Flash";
			status = "okay";
			};
	};
};
